## linux/drivers/gpu/drm/i915/Kconfig
```kconfig
config SUPPORT_EDP_BRIDGE_TC358860
       bool "EDP to MIPI TC358860 Bridge"
       depends on DRM || DRM_I915
       default n
       help
         xxxxxx
```
